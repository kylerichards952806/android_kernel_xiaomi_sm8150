## drivers/power/supply/maxim/Kconfig
```kconfig
menu "Maxim Integrated Products, Inc. Charger support"

config BATT_VERIFY_BY_DS28E16
	tristate
	prompt "Support ds28e16 as encryption IC."
	help
	  It needs a onewire physical controller to work.

config BATT_VERIFY_FORCE_VERIFIED
	bool "Report the battery as verified without running DS28E16 authentication"
	depends on BATT_VERIFY_BY_DS28E16
	help
	  Keep the DS28E16 driver and its "batt_verify" power supply, but
	  answer the authentication result (and chip presence) as verified
	  without doing the 1-Wire handshake.  Useful with an aftermarket
	  pack: a failed handshake leaves SMB5's unverified-battery FCC cap
	  in place, which holds charging at ~18 W.

	  Say N to authenticate real DS28E16 packs and keep the charge cap
	  for anything that fails the handshake.

config ONEWIRE_GPIO
	tristate
	prompt "Support Onewire Driver."
	help
	  It's an onewire driver.

endmenu
```

## drivers/power/supply/ti/Kconfig
```kconfig
menu "TI Technologies, Inc. Charger support"

config BQ2597X_CHARGE_PUMP
	tristate "BQ2597X power supply framework based driver"
	depends on I2C
	help
	  Say Y to include support for BQ2597X Charge Pump driver based on
	  power supply framework.
	  BQ2597X is a div2 charge pump capable of delivering 8A charge current
	  with very high efficiency.

config MI_QC3_PD_POLICY
	tristate "Mi QC3 and PD charge policy managers"
	select BQ2597X_CHARGE_PUMP
	help
	  Say Y to enable support for QC3 and PD Charge
	  policy managers from MI

endmenu
```
